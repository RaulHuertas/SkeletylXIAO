## boards/shields/skeletylxiao/Kconfig.defconfig
```kconfig
if SHIELD_SKELETYLXIAO_LEFT || SHIELD_SKELETYLXIAO_DONGLE

# Name must be less than 16 characters long!
config ZMK_KEYBOARD_NAME
    default "SkeletylXIAO"

config ZMK_USB_LOGGING
    default y

config LOG_PROCESS_THREAD_STARTUP_DELAY_MS
    default 8000

endif

if SHIELD_SKELETYLXIAO_LEFT || SHIELD_SKELETYLXIAO_RIGHT

config ZMK_SPLIT
    default y

config ZMK_SPLIT_ROLE_CENTRAL
    default n
    
endif





if SHIELD_SKELETYLXIAO_DONGLE

config ZMK_SPLIT
    default y

config ZMK_SPLIT_ROLE_CENTRAL
    default y



# Set this to the number of peripherals your dongle will have.
# For a unibody, this would be 1. If you have left and right halves, set it to 2, etc.
config ZMK_SPLIT_BLE_CENTRAL_PERIPHERALS
    default 2

# Set this to ZMK_SPLIT_BLE_CENTRAL_PERIPHERALS + your desired number of BT profiles (default is 5)
config BT_MAX_CONN
    default 7

# Set this to the same number as BT_MAX_CONN
config BT_MAX_PAIRED
    default 7

endif
```

## boards/shields/skeletylxiao/Kconfig.shield
```kconfig
# No whitespace after the comma or in your part name!
config SHIELD_SKELETYLXIAO_LEFT
    def_bool $(shields_list_contains,skeletylxiao_left)

# No whitespace after the comma or in your part name!
config SHIELD_SKELETYLXIAO_RIGHT
    def_bool $(shields_list_contains,skeletylxiao_right)

# No whitespace after the comma or in the keyboard name!
config SHIELD_SKELETYLXIAO_DONGLE
    def_bool $(shields_list_contains,skeletylxiao_dongle)
```
